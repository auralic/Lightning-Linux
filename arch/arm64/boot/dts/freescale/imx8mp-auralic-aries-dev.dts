// SPDX-License-Identifier: GPL-2.0-or-later OR MIT
/*
 * Copyright 2022 Toradex
 */

/dts-v1/;

#include "imx8mp-auralic.dtsi"
#include "imx8mp-auralic-aries.dtsi"

/ {
	model = "Toradex Verdin iMX8M Plus WB on Auralic Development Board";
	compatible = "toradex,verdin-imx8mp-wifi-dev",
		     "toradex,verdin-imx8mp-wifi",
		     "toradex,verdin-imx8mp",
		     "fsl,imx8mp";
};
